## examples/bluetooth/esp_hid_device/main/Kconfig.projbuild
```kconfig
menu "HID Example Configuration"
    config EXAMPLE_SSP_ENABLED
        bool "Secure Simple Pairing"
        depends on BT_CLASSIC_ENABLED
        default y
        help
            This enables the Secure Simple Pairing. If disable this option,
            Bluedroid will only support Legacy Pairing

    choice EXAMPLE_HID_DEVICE_ROLE
        prompt "HID Device Role"
        depends on BT_NIMBLE_ENABLED
        default EXAMPLE_MEDIA_ENABLE
        help
            Three Supported Roles for Device
            - Media Device
            - Keyboard
            - Mouse

        config EXAMPLE_MEDIA_ENABLE
            select BT_NIMBLE_HID_SERVICE
            bool "Enable Media Device"

        config EXAMPLE_KBD_ENABLE
            select BT_NIMBLE_HID_SERVICE
            bool "Enable Keyboard Device"

        config EXAMPLE_MOUSE_ENABLE
            select BT_NIMBLE_HID_SERVICE
            bool "Enable Mouse Device"
    endchoice

    choice BLINK_LED
        prompt "Blink LED type"
        default BLINK_LED_GPIO
        help
            Select the LED type. A normal level controlled LED or an addressable LED strip.
            The default selection is based on the Espressif DevKit boards.
            You can change the default selection according to your board.

        config BLINK_LED_GPIO
            bool "GPIO"
        config BLINK_LED_STRIP
            bool "LED strip"
    endchoice

    choice BLINK_LED_STRIP_BACKEND
        depends on BLINK_LED_STRIP
        prompt "LED strip backend peripheral"
        default BLINK_LED_STRIP_BACKEND_RMT if SOC_RMT_SUPPORTED
        default BLINK_LED_STRIP_BACKEND_SPI
        help
            Select the backend peripheral to drive the LED strip.

        config BLINK_LED_STRIP_BACKEND_RMT
            depends on SOC_RMT_SUPPORTED
            bool "RMT"
        config BLINK_LED_STRIP_BACKEND_SPI
            bool "SPI"
    endchoice

    config EXAMPLE_HID_DEVICE_ROLE
        int
        default 1 if EXAMPLE_MEDIA_ENABLE
        default 2 if EXAMPLE_KBD_ENABLE
        default 3 if EXAMPLE_MOUSE_ENABLE
endmenu
```
